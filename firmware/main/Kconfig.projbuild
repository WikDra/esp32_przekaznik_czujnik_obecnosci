## firmware/main/Kconfig.projbuild
```kconfig
menu "Swiatlo LD2420 - configuration"

    menu "Pin map (ESP32-C3 SuperMini)"

        config APP_RELAY_GPIO
            int "Relay IN pin"
            default 10
            range 0 21
            help
                GPIO driving the IN pin of the 1-channel 5 V relay module.
                Go through the 4CH level shifter (LV side -> GPIO, HV side -> relay IN, HV = 5 V):
                a 3.3 V logic high is not guaranteed to switch OFF a 5 V low-level-trigger module.
                Avoid strapping pins (0, 2, 8, 9).

        config APP_RELAY_ACTIVE_LOW
            bool "Relay module is low-level triggered"
            default y
            help
                y  -> GPIO low = relay energized = lamp ON (HW-307 / JQC3F-05VDC-C module).
                n  -> GPIO high = relay energized.

        config APP_RELAY_OPEN_DRAIN
            bool "Drive the relay pin as open drain"
            default n
            help
                Enable when the relay IN pin is wired straight to the GPIO (no level
                shifter) together with an external 10 kO pull-up to +5 V. The GPIO then
                only pulls low and the resistor provides the full 5 V high level, which
                is what a 5 V low-level-trigger module needs to actually switch OFF.
                Leave disabled when using the 4CH level shifter (it has its own pull-ups).

        config APP_LED_GPIO
            int "Status LED pin (-1 = none)"
            default 8
            range -1 21
            help
                On the ESP32-C3 SuperMini the on-board LED sits on GPIO8 and is active low.

        config APP_LED_ACTIVE_LOW
            bool "Status LED is active low"
            default y

        config APP_BUTTON_GPIO
            int "Button pin (-1 = none)"
            default 9
            range -1 21
            help
                BOOT button on the ESP32-C3 SuperMini (GPIO9, active low, has a pull-up).
                Short press toggles the lamp, long press (>=5 s) performs a Matter factory reset.

        config APP_LD2420_UART_PORT
            int "LD2420 UART port"
            default 1
            range 0 1

        config APP_LD2420_RX_GPIO
            int "LD2420 UART RX pin (ESP RX <- sensor OT1/TX)"
            default 4
            range 0 21

        config APP_LD2420_TX_GPIO
            int "LD2420 UART TX pin (ESP TX -> sensor RX)"
            default 5
            range 0 21
            help
                Required: without TX the thresholds cannot be written to the sensor.

        config APP_LD2420_OT2_GPIO
            int "LD2420 OT2 digital presence pin (-1 = unused)"
            default -1
            range -1 21
            help
                Optional. The driver derives presence from the UART stream, OT2 is only
                used as a redundant/fast signal when set to a valid GPIO.

    endmenu

    menu "Default behaviour"

        config APP_AUTO_MODE_DEFAULT
            bool "Presence automation enabled by default"
            default y

        config APP_HOLD_SECONDS_DEFAULT
            int "Default hold time after presence is lost (s)"
            default 60
            range 0 3600

        config APP_MAX_DISTANCE_CM_DEFAULT
            int "Default max accepted distance (cm, 0 = no limit)"
            default 400
            range 0 1000

        config APP_MIN_DISTANCE_CM_DEFAULT
            int "Default min accepted distance (cm)"
            default 0
            range 0 1000

        config APP_HYSTERESIS_CM_DEFAULT
            int "Default hysteresis around the distance window (cm)"
            default 30
            range 0 300
            help
                Occupancy is entered at max_cm and only cleared above max_cm + hysteresis.
                Prevents the lamp from flickering when somebody stands at the edge of the
                configured range.

        config APP_PRESENCE_SRC_DEFAULT
            int "Default presence source (0 = flag AND distance, 1 = distance only, 2 = flag only)"
            default 1
            range 0 2
            help
                Many LD2420 units keep the presence flag at 1 permanently (it also reacts
                to walls and furniture), so deriving occupancy from the reported distance
                (1) is the more reliable default. Mode 1 needs max_cm > 0; with max_cm = 0
                the firmware falls back to the module flag.

        config APP_RESTORE_STATE_DEFAULT
            bool "Restore last lamp state after reboot"
            default n

    endmenu

    menu "Time and dusk (no light sensor)"

        config APP_NIGHT_ONLY_DEFAULT
            bool "Only switch the lamp on after dusk by default"
            default n
            help
                When enabled the presence automation ignores detections during the day.
                Manual control (Matter, panel, button) always works.
                Fail-safe: until the clock is synchronized the firmware treats the time
                as night, so the automation keeps working.

        config APP_NTP_SERVER_DEFAULT
            string "SNTP server"
            default "pool.ntp.org"

        config APP_TZ_DEFAULT
            string "POSIX timezone string"
            default "CET-1CEST,M3.5.0,M10.5.0/3"
            help
                Format like in /etc/TZ. Poland: CET-1CEST,M3.5.0,M10.5.0/3
                (offsets have inverted signs: CET-1 means UTC+1).

        config APP_LATITUDE_UDEG_DEFAULT
            int "Latitude in microdegrees (52229700 = 52.2297 N)"
            default 52229700
            range -90000000 90000000

        config APP_LONGITUDE_UDEG_DEFAULT
            int "Longitude in microdegrees (21012200 = 21.0122 E)"
            default 21012200
            range -180000000 180000000

        config APP_SUNSET_OFFSET_MIN_DEFAULT
            int "Sunset offset (minutes, negative = earlier)"
            default -30
            range -180 180

        config APP_SUNRISE_OFFSET_MIN_DEFAULT
            int "Sunrise offset (minutes, positive = later)"
            default 30
            range -180 180

    endmenu

    menu "Power cycle override"

        config APP_POWER_CYCLE_FORCE_ON
            bool "Force the lamp ON after N quick power cycles"
            default y
            help
                Lets you switch the lamp on from the wall fuse / socket when the radar
                or the network misbehaves: cut the power twice in quick succession and
                the lamp comes up ON with the presence automation bypassed until the
                next explicit OFF (Matter, panel or button).
                A quick reset counts the same way as a power cut.

        config APP_POWER_CYCLE_COUNT
            int "Number of power cycles that triggers force ON"
            depends on APP_POWER_CYCLE_FORCE_ON
            default 2
            range 2 5

        config APP_POWER_CYCLE_WINDOW_S
            int "Power cycle counting window (s)"
            depends on APP_POWER_CYCLE_FORCE_ON
            default 10
            range 2 60
            help
                If the device stays powered for longer than this, the counter is cleared.

    endmenu

    menu "HTTP panel"

        config APP_WEB_PORT
            int "HTTP port"
            default 80
            range 1 65535

        config APP_WEB_AUTH
            bool "Require HTTP Basic authentication"
            default y
            help
                Strongly recommended: the panel switches mains voltage.
                Without it anybody on the LAN can toggle the lamp.

        config APP_WEB_USER
            string "HTTP user"
            depends on APP_WEB_AUTH
            default "admin"

        config APP_WEB_PASS
            string "HTTP password"
            depends on APP_WEB_AUTH
            default "swiatlo"
            help
                CHANGE THIS. HTTP Basic auth is sent base64-encoded over plain HTTP,
                so it only protects against casual access on a trusted LAN.

    endmenu

endmenu
```
